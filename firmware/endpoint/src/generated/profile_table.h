#ifndef SX1278_GENERATED_PROFILE_TABLE_H
#define SX1278_GENERATED_PROFILE_TABLE_H
#include <stddef.h>
#include <stdint.h>
#ifdef __AVR__
#include <avr/pgmspace.h>
#else
#define PROGMEM
#endif
namespace sx1278 {
namespace generated {
struct RegisterSetting {
  uint8_t profile_code;
  uint8_t bank;
  uint8_t address;
  uint8_t write_value;
  uint8_t readback_mask;
  uint8_t expected_readback;
};
struct ProfileSlice {
  uint8_t profile_code;
  uint16_t first;
  uint8_t count;
};
static const uint8_t kProfileDatasheetAuditComplete = 1U;
static const uint8_t kProfileHumanApprovalComplete = 0U;
static const uint8_t kProfilePhysicalReadbackComplete = 0U;
static const uint16_t kRegisterSettingCount = 127U;
static const uint8_t kProfileCount = 6U;
static const RegisterSetting kRegisterSettings[] PROGMEM = {
    {0U, 1U, 0x01U, 0x88U, 0xCFU, 0x88U},
    {0U, 1U, 0x06U, 0x6DU, 0xFFU, 0x6DU},
    {0U, 1U, 0x07U, 0x60U, 0xFFU, 0x60U},
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    {5U, 2U, 0x40U, 0x00U, 0xFFU, 0x00U},
};
static const ProfileSlice kProfileSlices[6] PROGMEM = {
    {0U, 0U, 19U},
    {1U, 19U, 22U},
    {2U, 41U, 22U},
    {3U, 63U, 22U},
    {4U, 85U, 22U},
    {5U, 107U, 20U},
};
static const uint8_t kProfileTableSha256[32] PROGMEM = {0x5D, 0xC7, 0xD6, 0x75, 0x54, 0xE5, 0x33, 0xAD, 0x2E, 0x8C, 0x8A, 0x66, 0xFA, 0xDB, 0x92, 0xEC, 0xDC, 0x61, 0xA5, 0x5A, 0x6E, 0xC3, 0x46, 0xF7, 0x56, 0xD7, 0x33, 0x30, 0xA8, 0x0B, 0x4E, 0x8E};
/** Read one bounded register row from native memory or AVR flash.
 * Processing flow: index -> bounds check -> platform copy -> result.
 */
inline bool read_register_setting(uint16_t index, RegisterSetting* output) {
  if (output == 0) {
    return false;
  }
  if (index >= kRegisterSettingCount) {
    return false;
  }
#ifdef __AVR__
  memcpy_P(output, &kRegisterSettings[index], sizeof(RegisterSetting));
#else
  *output = kRegisterSettings[index];
#endif
  return true;
}
/** Read one bounded profile slice from native memory or AVR flash.
 * Processing flow: profile code -> bounds check -> platform copy -> result.
 */
inline bool read_profile_slice(uint8_t profile_code, ProfileSlice* output) {
  if (output == 0) {
    return false;
  }
  if (profile_code >= kProfileCount) {
    return false;
  }
#ifdef __AVR__
  memcpy_P(output, &kProfileSlices[profile_code], sizeof(ProfileSlice));
#else
  *output = kProfileSlices[profile_code];
#endif
  return true;
}
/** Read one SHA-256 byte from native memory or AVR flash.
 * Processing flow: index/output checks -> platform read -> byte result.
 */
inline bool read_profile_hash_byte(uint8_t index, uint8_t* output) {
  if (output == 0) {
    return false;
  }
  if (index >= 32U) {
    return false;
  }
#ifdef __AVR__
  *output = pgm_read_byte(&kProfileTableSha256[index]);
#else
  *output = kProfileTableSha256[index];
#endif
  return true;
}
}
}
#endif
